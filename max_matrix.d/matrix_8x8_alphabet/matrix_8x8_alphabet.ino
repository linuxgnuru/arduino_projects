//We always have to include the library
#include "LedControl.h"
#include <string.h>
#include <ctype.h>

/*
 Now we need a LedControl to work with.
 ***** These pin numbers will probably not work with your hardware *****
 pin 12 is connected to the DataIn
 pin 11 is connected to the CLK
 pin 10 is connected to LOAD
 We have only a single MAX72XX.
 */
LedControl lc = LedControl(4, 3, 2, 1);

#define MAX_SZ 80

//const int vccPin = ;
// const int gndPin = ;
const int buttonPin = 7;

int  buttonState; // current reading from the input pin
int  lastButtonState = LOW; // previous reading from the input pin
long lastDebounceTime = 0; // last time the output pin was toggled

long debounceDelay = 50; // debounce time; increase if the output flickers
char message[MAX_SZ];
// we always wait a bit between updates of the display
unsigned long delaytime = 500;

byte font[128][8] = {
  { 0x00, 0x00, 0x00, 0x00, 0x00, 0x00, 0x00, 0x00},   // U+0000 (nul)
  { 0x00, 0x00, 0x00, 0x00, 0x00, 0x00, 0x00, 0x00},   // U+0001
  { 0x00, 0x00, 0x00, 0x00, 0x00, 0x00, 0x00, 0x00},   // U+0002
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  { 0x00, 0x00, 0x00, 0x00, 0x00, 0x00, 0x00, 0x00}    // U+007F
};

void setup()
{
  pinMode(buttonPin, INPUT_PULLUP);
  // The MAX72XX is in power-saving mode on startup, we have to do a wakeup call
  lc.shutdown(0, false);
  // Set the brightness to a medium values
  lc.setIntensity(0, 8);
  // and clear the display
  lc.clearDisplay(0);
  Serial.begin(9600);
  Serial.println("Ready for message.");
}

byte b[8];

void loop()
{
  printAll();
//      serialPrint();
//  ledPrint("Habari kwa Maisha na Maji!   Welcome to Maisha na Maji!");
  /*
    writeArduinoOnMatrix();
    habari();
    serialPrint();
    rows();
    columns();
    single();
    */
}

void printAll()
{
  for (int i = 32; i < 127; i++)
  {
    for (int j = 0; j < 8; j++)
      b[j] = font[i][j];
    for (int j = 0; j < 8; j++)
      lc.setColumn(0, j, b[j]);
    delay(delaytime/6);
    lc.clearDisplay(0);
    delay(delaytime / 4);
//    pause();
  }
}

void pause()
{
  int reading;
  boolean stopFlag = false;

  while (stopFlag == false)
  {
    reading = digitalRead(buttonPin);
    if (reading != lastButtonState)
      lastDebounceTime = millis();
    if ((millis() - lastDebounceTime) > debounceDelay)
    {
      if (reading != buttonState)
      {
        buttonState = reading;
        if (buttonState == LOW)
          stopFlag = true;
      }
    }
    lastButtonState = reading;
  }
}

void ledPrint(char *message)
{
  byte b[8];
  for (int i = 0; i < strlen(message); i++)
  {
    for (int j = 0; j < 8; j++)
      b[j] = font[message[i]][j];
    for (int j = 0; j < 8; j++)
      lc.setColumn(0, j, b[j]);
    delay(delaytime - 100);
    lc.clearDisplay(0);
    delay(delaytime / 4);
  }
}

/*
void ledPrintChar(char c)
{
  byte b[8];
    lc.clearDisplay(0);
  for (int i = 0; i < 8; i++)
    b[i] = font[c][i];
  for (int i = 0; i < 8; i++)
    lc.setColumn(0, i, b[i]);
  //  delay(delaytime - 100);
}

char c;
void serialPrint()
{
  if (Serial.available())
  {
    while (Serial.available() > 0) // Don't read unless
    {
      c = Serial.read();
      lc.clearDisplay(0);
      delay(delaytime);
      ledPrintChar(c);
    }
  }
}
*/

//#if 0
void serialPrint()
{
  if (Serial.available())
  {
    if (readSerial() != false)
    {
//      lc.clearDisplay(0);
//      delay(delaytime);
      ledPrint(message);
    }
  }
}

int readSerial()
{
  char inChar;
  byte index = 0;
  boolean isData = false;

  while (Serial.available() > 0) // Don't read unless
  {
    if (index < MAX_SZ - 1) // One less than the size of the array
    {
      inChar = Serial.read(); // Read a character
      message[index] = inChar; // Store it
      index++; // Increment where to write next
      message[index] = '\0'; // Null terminate the string
      isData = true;
    }
  }
  return isData;
}
//#endif

